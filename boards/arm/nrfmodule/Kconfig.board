## boards/arm/nrfmodule/Kconfig.board
```kconfig
# NRFMODULE board configuration

# Copyright (c) 2025 Moritz Plattner
# SPDX-License-Identifier: MIT

config BOARD_NRFMODULE
    bool "nrfmodule"
    depends on SOC_NRF52840_QIAA
```
